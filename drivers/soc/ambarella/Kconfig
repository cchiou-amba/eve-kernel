## drivers/soc/ambarella/Kconfig
```kconfig
#
# Ambarella SoC drivers
#

menu "Ambarella SoC drivers"

config AMBARELLA_VOUT_RPC
	bool "Ambarella VOUT typed RPC"
	depends on ARCH_AMBARELLA
	default y
	help
	  Build the stable in-kernel typed RPC interface used by Ambarella
	  display producers and the VOUT provider.

config AMBARELLA_SUPPORT_GDMA
	bool "Ambarella Enable GDMA"
	depends on ARCH_AMBARELLA
	default n
	help
	  Say y here to enable gdma

config AMBARELLA_LPDDR5_ADJUST
	bool "Ambarella adjust lpddr5 dynamically"
	depends on ARCH_AMBARELLA
	default n
	help
	  Say y here to adjust lpddr5 dynamically

source "drivers/soc/ambarella/pcie/Kconfig"
endmenu
```

## drivers/soc/ambarella/pcie/Kconfig
```kconfig
#
# Ambarella PCIe drivers
#

config AMBARELLA_PCIE_VETH
	tristate "Ambarella PCIe Virtual Network"
	depends on ARCH_AMBARELLA && PCI
	default n
	help
	  Say y here to enable Ambarella PCIe Virtual Network
```
